// SPDX-License-Identifier: (GPL-2.0+ OR MIT)
/*
 * Copyright (c) 2019 BayLibre, SAS
 * Author: Neil Armstrong <narmstrong@baylibre.com>
 */
/dts-v1/;

#include "meson-sm1.dtsi"

/ {
	aliases {
		serial0 = &uart_AO;
		ethernet0 = &ethmac;
	};
};
